#include "torabo_tsuki_lp.dtsi"
#include <input/processors.dtsi>
#include <dt-bindings/zmk/input_transform.h>

&trackball_listener {
    // Default: mouse movement mode
    input-processors = <
        &zip_xy_transform (INPUT_TRANSFORM_X_INVERT | INPUT_TRANSFORM_Y_INVERT)
    >;

    // When layer 4 (MOUSE) is active: slow mode for precise selection
    slow_mode {
        layers = <4>;
        input-processors = <
            &zip_xy_transform (INPUT_TRANSFORM_X_INVERT | INPUT_TRANSFORM_Y_INVERT)
            &zip_xy_scaler 1 3
        >;
    };

    // When layer 5 is active: scroll mode
    scroller {
        layers = <5>;
        input-processors = <
            &zip_xy_transform INPUT_TRANSFORM_X_INVERT
            &zip_xy_scaler 1 8
            &zip_xy_to_scroll_mapper
        >;
    };
};